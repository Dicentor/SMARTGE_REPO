## sdkconfig.defaults
```kconfig
ini
# Wi‑Fi Robustheit
CONFIG_ESP_WIFI_STATIC_RX_BUFFER_NUM=16
CONFIG_ESP_WIFI_DYNAMIC_RX_BUFFER_NUM=64
CONFIG_ESP_WIFI_STATIC_TX_BUFFER=y
CONFIG_ESP_WIFI_TX_BUFFER_TYPE=1


# HTTP Client
CONFIG_ESP_HTTP_CLIENT_ENABLE_HTTPS=y


# RMT / LED Strip
CONFIG_RMT_ISR_IRAM_SAFE=y
```
